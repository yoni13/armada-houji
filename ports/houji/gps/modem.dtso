// SPDX-License-Identifier: GPL-2.0-only
// Loaded by the cellular service after stock firmware and licensing are ready.
/dts-v1/;
/plugin/;

/ {
	compatible = "xiaomi,houji";
	fragment@100 {
		target-path = "/soc@0/remoteproc@4080000";
		__overlay__ {
			firmware-name = "qcom/houji/modem/modem.mdt",
					"qcom/houji/modem/modem_dtb.mdt";
			status = "okay";
		};
	};
};

&ipa {
	qcom,gsi-loader = "self";
	memory-region = <&ipa_fw_mem>;
	firmware-name = "ipa_fws.mdt";
	status = "okay";
};
